/* https://github.com/crankyoldgit/IRremoteESP8266/blob/master/examples/IRsendDemo/IRsendDemo.ino
 */
#include <Arduino.h>
#include <WiFi.h>
#include <HTTPClient.h>
#include <ArduinoJson.h> // 請確保已安裝 ArduinoJson 程式庫
#include <IRremoteESP8266.h>
#include <IRsend.h>
#include <DHT.h> // 請確保已安裝 "DHT sensor library" 及其相依套件 "Adafruit Unified Sensor"

// --- 1. 基礎設定 ---
const char* ssid = "TP-Link_9B2E";
const char* password = "40180489";
const char* apiUrl = "https://ac.control.desmoco.com.tw/index.php?action=get_status";
const char* apiUrlReset = "https://ac.control.desmoco.com.tw/index.php?action=reset_status";

const uint16_t kIrLed = 4; 
IRsend irsend(kIrLed);

// --- DHT22 溫濕度感測器設定 ---
// GPIO4 已被紅外線 LED 使用，且需避開 ESP32 的 strapping pin (0,2,5,12,15)
// 故選用 GPIO27 作為 DHT22 資料腳位
#define DHTPIN 27
#define DHTTYPE DHT22
DHT dht(DHTPIN, DHTTYPE);
float lastTemperature = NAN; // 快取最近一次讀取成功的溫度

// --- 伺服器時間 ---
String serverTime = ""; // 儲存最近一次 API 回應的伺服器時間

// --- 2. 紅外線原始代碼 (Raw Data) ---
// 功能鍵 冷氣
uint16_t fn2ac[139] = {8944, 4556,  660, 1648,  660, 546,  658, 548,  658, 1648,  660, 1648,  634,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 1700,  610};
// 功能鍵 送風
uint16_t fn2fan[139] = {8924, 4554,  632, 1676,  582, 1724,  582, 622,  584, 1724,  582, 1724,  608,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 1674,  634};
//uint16_t fn2fan[139] = {8946, 4530,  582, 1724,  608, 1698,  582, 624,  608, 1698,  582, 1726,  582,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 1670,  636};
// 23度開機
uint16_t on23[139] = {8976, 4524,  614, 1666,  642, 592,  614, 568,  638, 1668,  638, 568,  638,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 1694,  614};
// 關機
uint16_t offac[139] = {8998, 4478,  660, 544,  660, 1648,  660, 546,  634, 570,  634, 1672,  634,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 570,  634};
// 26度
uint16_t at26o[139] = {8994, 4480,  660, 1646,  662, 544,  660, 544,  660, 1646,  660, 1646,  660,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 1672,  634};
// 25度
uint16_t at25o[139] = {9002, 4476,  662, 1646,  660, 546,  660, 546,  660, 1646,  660, 1646,  662,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 1672,  634};
// 27度
uint16_t at27o[139] = {8970, 4558,  632, 1674,  634, 574,  632, 572,  630, 1676,  634, 1672,  608,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 624,  582};

// 定時4.5小時候關
uint16_t at405hr2Off[279] = {8972, 4502,  634, 1674,  660, 1648,  634, 572,  658, 1648,  660, 1648,  660,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 1672,  636};

// 關機時2.5小時
uint16_t at205hr2On[279] = {9026, 4476,  660, 546,  660, 1648,  658, 544,  662, 546,  660, 1646,  660,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 1676,  634};
// 定時0.5小時候關
uint16_t at005hr2Off[279] = {9026, 4478,  662, 1648,  660, 1648,  660, 544,  660, 1646,  660, 1648,  660,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 1672,  634};

void setup() {
  Serial.begin(115200);
  irsend.begin();
  pinMode(LED_BUILTIN, OUTPUT);
  dht.begin(); // 初始化 DHT22

  // 連接 WiFi
  WiFi.begin(ssid, password);
  Serial.print("連線中");
  while (WiFi.status() != WL_CONNECTED) {
    delay(1000);
    Serial.print(".");
  }
  Serial.println("\nWiFi 已連線！");
  
  // 連線成功閃三下提示
  at_section(3); 
}

void loop() {
  // 讀取 DHT22 溫度（讀取失敗時沿用上一次成功的數值，避免傳送 NaN）
  float temperature = dht.readTemperature();
  float humidity = dht.readHumidity(); // 濕度僅用於測試階段輸出確認，暫不上傳
  if (isnan(temperature)) {
    Serial.println("DHT22 讀取失敗，沿用上次數值");
    temperature = lastTemperature;
  } else {
    lastTemperature = temperature;
  }

  // --- 測試用：將 DHT22 讀值直接輸出至序列埠(Serial Monitor)，方便確認感測器是否正常 ---
  Serial.print("[DHT22] 溫度: ");
  if (isnan(temperature)) {
    Serial.print("讀取失敗");
  } else {
    Serial.print(temperature, 1);
    Serial.print(" C");
  }
  Serial.print("  濕度: ");
  if (isnan(humidity)) {
    Serial.println("讀取失敗");
  } else {
    Serial.print(humidity, 1);
    Serial.println(" %");
  }

  if (WiFi.status() == WL_CONNECTED) {
    HTTPClient http;

    // 將溫度以 URL 參數附加送出（讀取失敗時不附加）
    String requestUrl = apiUrl;
    if (!isnan(temperature)) {
      requestUrl += "&temp=" + String(temperature, 1);
    }
    http.begin(requestUrl);

    // 收集 Date 標頭以取得伺服器時間
    const char* headerKeys[] = {"Date"};
    http.collectHeaders(headerKeys, 1);

    int httpCode = http.GET();

    if (httpCode > 0) {
      // 取得伺服器時間並存入變數
      if (http.hasHeader("Date")) {
        // HTTP Date 格式: "Wed, 02 Jul 2026 10:03:41 GMT"
        // 只保留時間段，索引 17~24，共 8 碼
        serverTime = http.header("Date").substring(17, 25);
        Serial.println("伺服器時間: " + serverTime);
      }

      String payload = http.getString();

      // 解析 JSON
      StaticJsonDocument<200> doc;
      DeserializationError error = deserializeJson(doc, payload);

      if (!error) {
        String cmd = doc["command"]; // 取得 API 中的指令字串
        bool done = doc["done"];     // 取得指令是否已執行完畢

        // 'reset' 代表無待執行指令，直接略過
        if (cmd == "reset") {
          http.end();
          delay(3000);
          return;
        }

        // done 為 true 代表指令已執行完畢，略過不重複執行
        if (done) {
          http.end();
          delay(3000);
          return;
        }

        at_section(3); // 發送訊號閃三下提示

        executeCommand(cmd);     // 跳轉到判斷邏輯
        resetStatus(); // 執行完畢後，通知伺服器重置指令，避免重複執行

      }
    }
    http.end();
  }
  
  delay(3000); // 每 3 秒檢查一次伺服器
}

// --- 3. 判斷指令與發送 (Switch Case 邏輯) ---
void executeCommand(String cmd) {
  // 將字串轉為整數編號，因為 switch 不支援字串 
  if (cmd == "POWER_ON_23") {
    Serial.println("執行：開機 23度");
    irsend.sendRaw(on23, 139, 38);
    } 
  else if (cmd == "TEMP_25") {
    Serial.println("執行：設定 25度");
    irsend.sendRaw(at25o, 139, 38);
  }
  else if (cmd == "TEMP_26") {
    Serial.println("執行：設定 26度");
    irsend.sendRaw(at26o, 139, 38);
  } 
  else if (cmd == "TEMP_27") {
    Serial.println("執行：設定 27度");
    irsend.sendRaw(at27o, 139, 38);
  } 
  else if (cmd == "OFF_0H5") {
    Serial.println("執行：送風0.5小時後關機");
    irsend.sendRaw(fn2fan, 139, 38);
    delay(5000);
    irsend.sendRaw(at005hr2Off, 279, 38);
  } 
  else if (cmd == "OFF_4H5") {
    Serial.println("執行：送風4.5小時後關機");
    irsend.sendRaw(fn2fan, 139, 38);
    delay(5000);
    irsend.sendRaw(at405hr2Off, 279, 38);
  } 
  else if (cmd == "reset") {
    return; // 無待執行指令，略過
  }
  else {
    Serial.println("未知指令: " + cmd);
  }
}

void timing(String cmd) {

  // 解析 JSON
  StaticJsonDocument<200> doc;
  DeserializationError error = deserializeJson(doc, cmd);

  if (!error) {
    // 比對時間: (打台灣台北地區時間api以取得時間)


    // 時間到:執行程式

    // 時間未到:跳出本函式
  } else {
    Serial.println("JSON 解析錯誤: " + String(error.c_str()));
  }
}

// 執行完紅外線訊號後，通知伺服器將指令重置為 'reset'
void resetStatus() {
  if (WiFi.status() == WL_CONNECTED) {
    HTTPClient http;
    http.begin(apiUrlReset);
    int httpCode = http.GET();
    if (httpCode > 0) {
      String payload = http.getString();
      Serial.println("重置回應: " + payload);
    } else {
      Serial.println("重置失敗，HTTP 錯誤: " + String(httpCode));
    }
    http.end();
  }
}

// 檢查區塊用的 LED 閃爍函數
void at_section(int i) {
  for (int j = 0; j < i; j++) {
    digitalWrite(LED_BUILTIN, HIGH);
    delay(200);
    digitalWrite(LED_BUILTIN, LOW);
    delay(200);
  }
}
